## main/Kconfig.projbuild
```kconfig
menu "Bitaxe Configuration"

    menu "GPIO Pin Configuration"

        config GPIO_BUTTON_BOOT
            int "Boot button GPIO pin"
            default 0
            help
                GPIO pin connected to the BOOT button.

        config GPIO_ASIC_RESET
            int "ASIC reset GPIO pin"
            default 1
            help
                GPIO pin for ASIC_RESET (RST_N), reset input to ASIC.

        config GPIO_ASIC_ENABLE
            int "ASIC enable GPIO pin"
            default 10
            help
                GPIO pin for ASIC_ENABLE (POWER_EN), enable for core power supply.

        config GPIO_PLUG_SENSE
            int "Barrel plug sense GPIO pin"
            default 12
            help
                GPIO pin for DC barrel (PLUG_SENSE), sense pin of DC power jack socket.

        config GPIO_I2C_SDA
            int "I2C SDA Pin Override (-1 to use board default)"
            default -1
            help
                GPIO pin override for I2C SDA line. Set to -1 to use board default.
            
        config GPIO_I2C_SCL
            int "I2C SCL Pin Override (-1 to use board default)"
            default -1
            help
                GPIO pin override for I2C SCL line. Set to -1 to use board default.

        config ENABLE_BAP
            bool "Enable BAP (Bitaxe Accessory Protocol)"
            default y
            help
                Enable or disable Bitaxe Accessory Protocol (BAP) UART communication.

        config GPIO_BAP_RX
            int "BAP RX Pin Override (-1 to use board default)"
            default -1
            help
                GPIO pin override for BAP receiving line. Set to -1 to use board default.

        config GPIO_BAP_TX
            int "BAP TX Pin Override (-1 to use board default)"
            default -1
            help
                GPIO pin override for BAP transmitting line. Set to -1 to use board default.
            
    endmenu
    
    config ASIC_VOLTAGE
        int "ASIC Core Voltage (mV)"
        range 1000 1800
        default 1400
        help
            The core voltage to set the ASIC to. 1200 for BM1366 or 1400 for BM1397 is typical.

    config ASIC_FREQUENCY
        int "ASIC Hash Frequency (MHz)"
        range 50 800
        default 250
        help
            The BM1397 hash frequency
endmenu

menu "Stratum Configuration"

    config STRATUM_URL
        string "Stratum Address"
        default "public-pool.io"
        help
            The example will connect to this Stratum pool address.

    config STRATUM_PORT
        int "Stratum Port"
        range 0 65535
        default 21496
        help
            The stratum server port to connect to.
    
    choice
        prompt "Stratum TLS mode"
        default STRATUM_TLS_DISABLED
        help
            Select how TLS is used for stratum connections.

        config STRATUM_TLS_DISABLED
            bool "Disabled"

        config STRATUM_TLS_BUNDLED
            bool "Enabled (bundled CA certificate)"

        config STRATUM_TLS_CUSTOM
            bool "Enabled (user-provided/custom CA certificate)"
    endchoice

    config STRATUM_TLS
        int
        default 0 if STRATUM_TLS_DISABLED
        default 1 if STRATUM_TLS_BUNDLED
        default 2 if STRATUM_TLS_CUSTOM
    
    config STRATUM_CERT
        string "Stratum Certificate"
        default "x"
        help
            The certificate to use with the stratum connection.

    config EXTRANONCE_SUBSCRIBE
        bool "Pool extranonce subscribe"
        default n
        help
            Enable stratum extranonce subscribe.

    config FALLBACK_STRATUM_URL
        string "Fallback Stratum Address"
        default "solo.ckpool.org"
        help
            The example will connect to this Stratum pool address if the primary fails.

    config FALLBACK_STRATUM_PORT
        int "Fallback Stratum Port"
        range 0 65535
        default 3333
        help
            The stratum server port to connect to if the primary fails.
    
    choice
        prompt "Fallback Stratum TLS mode"
        default FALLBACK_STRATUM_TLS_DISABLED
        help
            Select how TLS is used for stratum connections.

        config FALLBACK_STRATUM_TLS_DISABLED
            bool "Disabled"

        config FALLBACK_STRATUM_TLS_BUNDLED
            bool "Enabled (bundled CA certificate)"

        config FALLBACK_STRATUM_TLS_CUSTOM
            bool "Enabled (user-provided/custom CA certificate)"
    endchoice

    config FALLBACK_STRATUM_TLS
        int
        default 0 if FALLBACK_STRATUM_TLS_DISABLED
        default 1 if FALLBACK_STRATUM_TLS_BUNDLED
        default 2 if FALLBACK_STRATUM_TLS_CUSTOM
    
    config FALLBACK_STRATUM_CERT
        string "Fallback Stratum Certificate"
        default "x"
        help
            The certificate to use with the stratum connection if the primary fails.

    config FALLBACK_EXTRANONCE_SUBSCRIBE
        bool "Fallback pool extranonce subscribe"
        default n
        help
            Enable fallback pool extranonce subscribe.

    config STRATUM_USER
        string "Stratum username"
        default "replace-this-with-your-btc-address.bitaxe"
        help
            Stratum user to use with pool

    config STRATUM_PW
        string "Stratum password"
        default "x"
        help
            Stratum password to use with pool

    config FALLBACK_STRATUM_USER
        string "Fallback Stratum username"
        default "replace-this-with-your-btc-address.bitaxe"
        help
            Fallback Stratum user to use with pool

    config FALLBACK_STRATUM_PW
        string "Fallback Stratum password"
        default "x"
        help
            Fallback Stratum password to use with pool

    config STRATUM_DIFFICULTY
        int "Stratum default difficulty"
        range 0 4294967296
        default 1000
        help
            A starting difficulty to use with the pool.

    config FALLBACK_STRATUM_DIFFICULTY
        int "Fallback stratum default difficulty"
        range 0 4294967296
        default 1000
        help
            A starting difficulty to use with the fallback pool.

    config ENABLE_TASK_MONITOR
        bool "Task Monitor"
        default n
        help
            Enable task monitor. NOTE: This is intended for debugging use only as the use of uxTaskGetSystemState results in the scheduler remaining suspended for an extended period.

endmenu

menu "HCS SHA Forge research"

    config TIMSMINER_SHA_RESEARCH
        bool "SHA research API (experimental)"
        default n
        help
            Compiles the on-device SHA-256 research oracle and the bounded
            research session API (/api/research/*).

            This does not change mining behaviour on its own. The API starts
            disarmed, refuses work while a pool is connected, while a share is
            outstanding, without a short-lived operator token, and outside its
            job/time budget. It computes SHA-256 and SHA-256d in software on the
            ESP32-S3 and returns the per-round values of that software
            computation. It gives no access to BM1366 internals: the ASIC only
            accepts mining-style SHA-256d work and returns nonces, so no
            "ASIC round" data exists to expose.

            Leave this off for a normal mining build.

    config TIMSMINER_SHA_RESEARCH_MAX_JOBS
        int "Research session job budget"
        depends on TIMSMINER_SHA_RESEARCH
        range 1 4096
        default 64
        help
            Hard upper bound on research jobs per armed session. The session
            disarms itself when the budget is spent; a new session needs a new
            operator token.

    config TIMSMINER_SHA_RESEARCH_MAX_RUNTIME_S
        int "Research session time budget (seconds)"
        depends on TIMSMINER_SHA_RESEARCH
        range 10 14400
        default 900
        help
            Active session time, excluding paused intervals. Research mode
            disarms when the budget is spent.

    config TIMSMINER_SHA_RESEARCH_TEMPERATURE_C
        int "Research thermal ceiling (degrees Celsius)"
        depends on TIMSMINER_SHA_RESEARCH
        range 35 70
        default 65
        help
            Research jobs are refused at or above this chip temperature. It can
            only tighten the device's own thermal protection, never raise it:
            the guard refuses a value above 70 C, and the existing thermal
            policy still owns overheat handling.

endmenu
```
